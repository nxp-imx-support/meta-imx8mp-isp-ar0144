## conf/layer.conf
```bitbake
# We have a conf and classes directory, add to BBPATH
BBPATH .= ":${LAYERDIR}"

# We have recipes-* directories, add to BBFILES
BBFILES += "${LAYERDIR}/recipes-*/*/*.bb \
            ${LAYERDIR}/recipes-*/*/*.bbappend"

BBFILE_COLLECTIONS += "meta-imx8mp-isp-ar0144"
BBFILE_PATTERN_meta-imx8mp-isp-ar0144 = "^${LAYERDIR}/"
BBFILE_PRIORITY_meta-imx8mp-isp-ar0144 = "9"

LAYERDEPENDS_meta-imx8mp-isp-ar0144 = "core"
LAYERSERIES_COMPAT_meta-imx8mp-isp-ar0144 = "mickledore"

KERNEL_DEVICETREE:append:imx8mp-lpddr4-evk = " \
	freescale/imx8mp-evk-ar0144.dtb \
"
```
